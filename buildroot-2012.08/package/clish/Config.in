## buildroot-2012.08/package/clish/Config.in
```kconfig
config BR2_PACKAGE_CLISH
	bool "clish"
	select BR2_PACKAGE_LIBXML2
	select BR2_PACKAGE_BINUTILS
	select BR2_PACKAGE_BINUTILS_TARGET
	  help
	    just for fun
```
